// include library
#include <SPI.h>
#include <Ethernet.h>
String devAddress="1101345102";

//Network Variable
byte mac[] = { 0x00, 0x51, 0x56, 0xC0, 0x00, 0x21 };
EthernetClient client;


//Connection Variable
//char server[] = "54.251.170.203";
char server[] = "140.127.149.157";

byte ipaddr []={140,127,149,156};
byte netmask[]={255,255,255,0};
byte getway[]={140,127,149,253};
byte googledns[]={168,95,1,1};

int port = 8080;
//String requestURL="GET /english/queryJuniorVocabulary.php?action=query HTTP/1.1";

String requestURL="GET /SolarManagementSystem/APP/log/test/";

String result="";

byte registerDev[][19] = {
    {0x00,0xFF,0x00,0x01,0x00,0x05,0x0A,0x00,0x05,0x00,0x00,0x30,0x40,0x10,0xA6,0x01,0x01,0x43,0x09},
    {0x00,0xFF,0x00,0x01,0x00,0x05,0x0A,0x00,0x05,0x00,0x00,0x30,0x40,0x10,0xB3,0x02,0x02,0x12,0x3C},
    {0x00,0xFF,0x00,0x01,0x00,0x05,0x0A,0x00,0x05,0x00,0x00,0x30,0x40,0x10,0xBD,0x03,0x03,0xB3,0xAF},
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    {0x00,0xFF,0x00,0x01,0x00,0x05,0x0A,0x00,0x05,0x00,0x00,0x32,0x70,0x90,0x92,0x10,0x10,0xA6,0xBD}
};

byte queryString[] [8] ={
{0x01,0x03,0x02,0x00,0x00,0x1E,0xCA,0x74},
{0x02,0x03,0x02,0x00,0x00,0x1E,0xCA,0x74},
{0x03,0x03,0x02,0x00,0x00,0x1E,0xCA,0x74},
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{0x10,0x03,0x02,0x00,0x00,0x1E,0xCA,0x74}
};

byte reset []={0x00,0xFE,0x00,0x02,0x00,0x00};



byte responseDataBuffer[90];
int devID=0;



void setup() {
    Serial.begin(9600);
    while (!Serial);
  
    ConectionConfig();
    Serial.print("Your ip is :");
    Serial.println(Ethernet.localIP());
   
    Serial.begin(9600);
    ConectionConfig();
}




void loop() {
   boolean queryDataresult=false;
   boolean registerDevStatus=false;
   int errcnt=0;
  
        for( devID = 0;devID <16 ; devID++){
        
            queryDataresult = sendQueryRequest(queryString[devID],8,responseDataBuffer,63);
            delay (1000);
 
            if (queryDataresult){
                 boolean requestStatus = false;
                 byteToString();
                 requestStatus=sendDataToCloud(result);
               
                if(requestStatus){
                    readBuffer(false);
                    disConnectionHttpRequest();
                }
                
                
            }
            else
            {
              registerDevStatus=sendQueryRequest(registerDev[devID],19,responseDataBuffer,63);
              
              if(!registerDevStatus){
                errcnt ++;
                
              }
              
              if(errcnt ==16){
                 boolean resetStatus =sendQueryRequest(reset,6,responseDataBuffer,63);
                 errcnt=0;
                 Serial.println("Remove All Register");
              }
            
            }
             delay(3000);
        }
}

boolean sendQueryRequest(byte queryBuffer [],int queryNum , byte resultByte[] , int resultNum ){
  
  
    readBuffer(false);
  
    for(int i = 0 ; i < queryNum ; i++)
    {
        Serial.write(queryBuffer[i]);
    }
    
    delay(500);
    int errorCount = 0;
    for(int i = 0 ; i < resultNum  ; i++)
    {
        if(Serial.available() )
        {    
            resultByte[i] = Serial.read();
            
        }
        else
        {
            i = i - 1;
            errorCount++;
            delay(3000);
        }
        
        if(errorCount ==3)
        {
            return false;
        }
    }
  
    return true;
  

}





boolean sendDataToCloud(String str)
{
  
  if (client.connect(server, 8080)) {
      //Serial.println("connected........");
      client.println(requestURL+devAddress+ "/"+result+ " HTTP/1.1");
      client.println("Host: www.google.com");
      client.println("Connection: close");
      client.println();
      
      delay(300);

      
      
  } 
  else {
    // if you didn't get a connection to the server:
    ConectionConfig();
      return false;
  }
  return true;



}
void byteToString(){
  result="";
  for (int i=0; i<63; i++){
    result+=responseDataBuffer[i];
  
  }


}

void readBuffer(boolean isPrint){
  
        while (client.available()) {
            char c = client.read();
            if(isPrint){
               Serial.print(c);  
            }
           

      }
   
}

void disConnectionHttpRequest(){

  if (!client.connected()) 
  {
    Serial.println();
    Serial.println("disconnecting.");
    client.stop();
  }
}



void ConectionConfig()
{
          Serial.print("Using DHCP Connect Method");
          Ethernet.begin(mac,ipaddr,googledns,getway,netmask);
          //Ethernet.begin(mac);
          delay(1000);
}
